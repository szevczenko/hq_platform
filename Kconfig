## Kconfig
```kconfig
mainmenu "hq_platform"

menu "Platform Selection"

choice
  prompt "Target platform"
  default HQ_PLATFORM_POSIX
  help
    Select the target platform for this build

config HQ_PLATFORM_POSIX
  bool "POSIX (Linux/Windows/macOS)"
  help
    Build for POSIX-compatible systems

config HQ_PLATFORM_ESP
  bool "ESP32 (ESP-IDF)"
  help
    Build for ESP32 microcontroller

config HQ_PLATFORM_STM32
  bool "STM32 (ARM Cortex-M)"
  depends on BROKEN
  help
    Build for STM32 microcontroller family

config HQ_PLATFORM_NXP
  bool "NXP (i.MX/MCUX)"
  depends on BROKEN
  help
    Build for NXP i.MX or MCUX platforms

endchoice

endmenu

source "src/osal/Kconfig"
source "src/cmd/Kconfig"
source "src/mongoose/Kconfig"
source "src/wifi_provisioning/Kconfig"
```

## examples/esp/hal_demo/main/Kconfig.projbuild
```kconfig
menu "HAL demo configuration"

config HAL_DEMO_GPIO_PIN
    int "GPIO pin driven by the HAL demo"
    default 4
    help
      Physical GPIO pad driven by the demo through the portable HAL GPIO API
      (hal_gpio_init/hal_gpio_write/hal_gpio_deinit).  The value is the pad
      number on the target SoC; the portable HAL treats it as an opaque
      hal_pin_t and never assumes a specific pad.  Select a free pad on your
      board.  The default targets the repository's reference ESP32 target.

config HAL_DEMO_PWM_PIN
    int "PWM pin driven by the HAL demo"
    default 18
    help
      Physical pad driven by the demo through the portable HAL PWM API
      (hal_pwm_init/hal_pwm_set_duty/hal_pwm_force_inactive/hal_pwm_deinit).
      The value is the pad number on the target SoC; the portable HAL treats
      it as an opaque hal_pin_t and never assumes a specific pad.  Select a
      free output-capable pad on your board.  The default targets the
      repository's reference ESP32 target.

endmenu
```

## examples/esp/thingboard_fwu/sdkconfig.defaults
```kconfig
CONFIG_PARTITION_TABLE_CUSTOM=y
CONFIG_PARTITION_TABLE_CUSTOM_FILENAME="partitions_ota.csv"
CONFIG_PARTITION_TABLE_OFFSET=0x8000
CONFIG_ESPTOOLPY_FLASHSIZE_4MB=y
CONFIG_BOOTLOADER_APP_ROLLBACK_ENABLE=y
```

## examples/esp/thingboard_rgb_lamp/main/Kconfig.projbuild
```kconfig
menu "ThingsBoard RGB Lamp Example"

config WIFI_SSID
  string "WiFi SSID"
  default "wifi_test"
  help
    WiFi access point SSID

config WIFI_PASSWORD
  string "WIFI password"
  default "12345678"
  help
    WiFi access point password

endmenu
```

## src/cmd/Kconfig
```kconfig
menu "Command Line"

choice
  prompt "ESP32 CMD output interface"
  depends on HQ_PLATFORM_ESP
  default CMD_ESP_OUTPUT_CONSOLE

config CMD_ESP_OUTPUT_CONSOLE
  bool "Use ESP-IDF console (stdout)"
  help
    CMD output goes through putchar()/stdout.
    Requires ESP-IDF console UART to be configured in menuconfig:
      Component Config -> ESP System Settings -> Console Output
        CONFIG_ESP_CONSOLE_UART_DEFAULT=y
        CONFIG_ESP_CONSOLE_UART_NUM=<port>
        CONFIG_ESP_CONSOLE_UART_BAUDRATE=<baud>

config CMD_ESP_OUTPUT_UART
  bool "Use direct UART driver"
  help
    CMD output goes directly to a UART peripheral.
    Does not use or conflict with the ESP-IDF console.
    Output only, no input handling.

endchoice

config CMD_ESP_UART_NUM
  int "UART port number"
  depends on CMD_ESP_OUTPUT_UART
  default 1
  range 0 2
  help
    UART peripheral for CMD output (0, 1, or 2).
    Avoid the port used by ESP-IDF console (usually 0).

config CMD_ESP_UART_BAUDRATE
  int "UART baudrate"
  depends on CMD_ESP_OUTPUT_UART
  default 115200
  help
    Baudrate for the CMD UART output.

config CMD_INPUT_TASK_STACK_SIZE
  int "Input task stack size (bytes)"
  default 65536 if HQ_PLATFORM_POSIX
  default 4096
  range 1024 131072

config CMD_INPUT_TASK_PRIORITY
  int "Input task priority"
  default 5
  range 1 25

config CMD_RX_BUFFER_SIZE
  int "CLI RX buffer size"
  default 256
  range 32 4096

config CMD_BUFFER_SIZE
  int "CLI command buffer size"
  default 256
  range 32 4096

config CMD_HISTORY_BUFFER_SIZE
  int "CLI history buffer size"
  default 512
  range 64 8192

config CMD_MAX_BINDING_COUNT
  int "CLI max binding count"
  default 32
  range 1 256

config CMD_ENABLE_AUTOCOMPLETE
  bool "Enable CLI autocomplete"
  default y

config CMD_INVITATION
  string "CLI invitation"
  default "hq> "

endmenu
```

## src/mongoose/Kconfig
```kconfig
menu "Mongoose"

config MQTT_DEFAULT_ADDRESS
  string "MQTT default broker address"
  default "mqtt://192.168.1.169:1883"
  help
    Default broker URL used when mqtt.json is not present.

config MQTT_DEFAULT_SSL
  bool "MQTT default SSL enabled"
  default n
  help
    Default SSL mode used when mqtt.json is not present.

config MQTT_DEFAULT_TOPIC_PREFIX
  string "MQTT default topic prefix"
  default "/config/"
  help
    Default MQTT topic prefix used when mqtt.json is not present.

config MQTT_DEFAULT_POST_TOPIC
  string "MQTT default post-data topic"
  default "/post_data/"
  help
    Default post-data topic used when mqtt.json is not present.

config MQTT_DEFAULT_USERNAME
  string "MQTT default username"
  default ""
  help
    Default MQTT username used when mqtt.json is not present.

config MQTT_DEFAULT_PASSWORD
  string "MQTT default password"
  default ""
  help
    Default MQTT password used when mqtt.json is not present.

config MQTT_DEFAULT_CLIENT_ID
  string "MQTT default client ID"
  default "hq_"
  help
    Default MQTT client ID used when mqtt.json is not present.

config MONGOOSE_LOG_LEVEL
  int "Mongoose log level"
  default 2
  range 0 4
  help
    0 = MG_LL_NONE
    1 = MG_LL_ERROR
    2 = MG_LL_INFO
    3 = MG_LL_DEBUG
    4 = MG_LL_VERBOSE

endmenu
```

## src/osal/Kconfig
```kconfig
menu "OSAL"

config OSAL_LOG_LEVEL
  int "OSAL log level"
  default 3
  range 0 3
  help
    0 = DEBUG
    1 = INFO
    2 = WARNING
    3 = ERROR

endmenu
```

## src/wifi_provisioning/Kconfig
```kconfig
menu "Wi-Fi Provisioning"

config WIFI_HTTP_PROVISIONING
  bool "Enable Wi-Fi HTTP provisioning"
  default n
  help
    Build the Mongoose and OSAL based Wi-Fi provisioning portal,
    captive DNS responder, automatic fallback controller, and the
    explicit start/stop API.

if WIFI_HTTP_PROVISIONING

config WIFI_HTTP_PROVISIONING_AUTO_FALLBACK
  bool "Enable automatic provisioning fallback controller"
  default y
  help
    Start the provisioning portal automatically when no usable saved
    credentials exist or when saved credentials fail to connect.

config WIFI_HTTP_PROVISIONING_FALLBACK_ATTEMPTS
  int "Consecutive saved-credential connect failures before fallback"
  range 0 64
  default 1
  help
    Number of consecutive CONNECT_FAILED events observed while the automatic
    fallback controller is awaiting a saved-credential connection before the
    provisioning portal opens. A value of 1 preserves the historical
    first-failure behavior; 0 disables the fallback entirely (the
    no-saved-credential start-on-init path is not affected). The controller
    resets the budget on any successful connect and re-arms it when it returns
    to the awaiting-connect state from an online connection. A per-device
    override can be installed at init time through
    wifi_provisioning_controller_config_t.fallback_budget.

config WIFI_HTTP_PROVISIONING_HTTP_URL
  string "Provisioning HTTP listen URL"
  default "http://0.0.0.0:80"
  help
    Mongoose listen URL for the provisioning HTTP portal.

config WIFI_HTTP_PROVISIONING_DNS_URL
  string "Captive DNS listen URL"
  default "udp://0.0.0.0:53"
  help
    Mongoose listen URL for the captive DNS responder. POSIX tests and
    demos should use a high port (for example udp://127.0.0.1:10053).

config WIFI_HTTP_PROVISIONING_DNS_TTL
  int "Captive DNS answer TTL in seconds"
  range 0 300
  default 30
  help
    TTL advertised in captive DNS A-record responses.

config WIFI_HTTP_PROVISIONING_SUCCESS_GRACE_MS
  int "Portal grace period after connection in milliseconds"
  range 0 60000
  default 5000
  help
    Time the provisioning portal remains active after a successful
    station connection before transitioning to STA-only.

config WIFI_HTTP_PROVISIONING_BODY_MAX
  int "Provisioning request body size limit (bytes)"
  range 128 4096
  default 1024
  help
    Upper bound in bytes for provisioning request bodies, notably the
    JSON payload submitted to POST /api/v1/wifi/credentials. Larger
    payloads are rejected with HTTP 413 before they are buffered.

endif

endmenu
```
